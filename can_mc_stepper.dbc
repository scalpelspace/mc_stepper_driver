VERSION ""

NS_ :

BS_:

BU_:

BO_ 257 state: 1 Vector__XXX
 SG_ system_state : 0|8@1+ (1,0) [0|255] "" Vector__XXX

BO_ 304 absolute_encoder: 4 Vector__XXX
 SG_ raw_position : 0|16@1+ (0,-1) [-1|1] "count" Vector__XXX
 SG_ angle : 16|16@1+ (0,360) [-1|1] "degrees" Vector__XXX

CM_ BO_ 257 "State machine info";
BA_DEF_  "BusType" STRING ;
BA_DEF_DEF_  "BusType" "CAN";
